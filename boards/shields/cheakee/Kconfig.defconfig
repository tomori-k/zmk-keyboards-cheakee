## boards/shields/cheakee/Kconfig.defconfig
```kconfig
config ZMK_SPLIT
    default y

config ZMK_POINTING
    default y

config ZMK_PM_SOFT_OFF
    default y

config SPI
    default y

config PMW3610
    default y

config PMW3610_INVERT_X
    default y

config PMW3610_REPORT_INTERVAL_MIN
    default 12

config ZMK_SLEEP
    default y

if ZMK_SPLIT_ROLE_CENTRAL

# Name must be less than 16 characters long!
config ZMK_KEYBOARD_NAME
    default "Cheakee"

config ZMK_SPLIT_BLE_CENTRAL_BATTERY_LEVEL_FETCHING
    default y

config ZMK_SPLIT_BLE_CENTRAL_BATTERY_LEVEL_PROXY
    default y

endif

config ZMK_SPLIT_ROLE_CENTRAL
    default y if (SHIELD_CHEAKEE_RIGHT && SHIELD_CHEAKEE_GROUP_RIGHT_CENTRAL)
    default y if (SHIELD_CHEAKEE_LEFT && SHIELD_CHEAKEE_GROUP_LEFT_CENTRAL)
```

## boards/shields/cheakee/Kconfig.shield
```kconfig
config SHIELD_CHEAKEE_LEFT
    def_bool $(shields_list_contains,cheakee_left) \
        || $(shields_list_contains,cheakee_left_no_ball) \
        || $(shields_list_contains,cheakee_left-central_left_ball_L) \
        || $(shields_list_contains,cheakee_left-central_left_ball_LR) \
        || $(shields_list_contains,cheakee_left-central_left_ball_R) \
        || $(shields_list_contains,cheakee_left-central_left_no_ball)

config SHIELD_CHEAKEE_RIGHT
     def_bool $(shields_list_contains,cheakee_right_ball_L) \
        || $(shields_list_contains,cheakee_right_ball_LR) \
        || $(shields_list_contains,cheakee_right_ball_R) \
        || $(shields_list_contains,cheakee_right_no_ball) \
        || $(shields_list_contains,cheakee_left-central_right) \
        || $(shields_list_contains,cheakee_left-central_right_no_ball)

# - cheakee_*                : 右が central
# - cheakee_left-central_*   : 左が central

config SHIELD_CHEAKEE_GROUP_RIGHT_CENTRAL
    def_bool $(shields_list_contains,cheakee_left) \
        || $(shields_list_contains,cheakee_left_no_ball) \
        || $(shields_list_contains,cheakee_right_ball_L) \
        || $(shields_list_contains,cheakee_right_ball_R) \
        || $(shields_list_contains,cheakee_right_ball_LR) \
        || $(shields_list_contains,cheakee_right_no_ball)

config SHIELD_CHEAKEE_GROUP_LEFT_CENTRAL
    def_bool $(shields_list_contains,cheakee_left-central_left_ball_L) \
        || $(shields_list_contains,cheakee_left-central_left_ball_R) \
        || $(shields_list_contains,cheakee_left-central_left_ball_LR) \
        || $(shields_list_contains,cheakee_left-central_left_no_ball) \
        || $(shields_list_contains,cheakee_left-central_right) \
        || $(shields_list_contains,cheakee_left-central_right_no_ball)
```

## boards/shields/cheakee_left-central/Kconfig.defconfig
```kconfig
rsource "../common/Kconfig.defconfig"

# LEFT: Central, RIGHT: Peripheral

if SHIELD_CHEAKEE_LEFT

config ZMK_SPLIT_ROLE_CENTRAL
    default y

endif

if SHIELD_CHEAKEE_RIGHT

config ZMK_SPLIT_ROLE_CENTRAL
    default n

endif
```

## boards/shields/common/Kconfig.defconfig
```kconfig
config ZMK_SPLIT
    default y

config ZMK_POINTING
    default y

config ZMK_PM_SOFT_OFF
    default y

config SPI
    default y

# config ZMK_SLEEP
#     default y

if ZMK_SPLIT_ROLE_CENTRAL

# Name must be less than 16 characters long!
config ZMK_KEYBOARD_NAME
    default "Cheakee"

config ZMK_SPLIT_BLE_CENTRAL_BATTERY_LEVEL_FETCHING
    default y

config ZMK_SPLIT_BLE_CENTRAL_BATTERY_LEVEL_PROXY
    default y

endif
```

## boards/shields/common/Kconfig.shield
```kconfig
config SHIELD_CHEAKEE_LEFT
    def_bool $(shields_list_contains,cheakee_left) \
        || $(shields_list_contains,cheakee_left_no_ball)

config SHIELD_CHEAKEE_RIGHT
     def_bool $(shields_list_contains,cheakee_right_ball_L) \
        || $(shields_list_contains,cheakee_right_ball_LR) \
        || $(shields_list_contains,cheakee_right_ball_R) \
        || $(shields_list_contains,cheakee_right_no_ball) \
        || $(shields_list_contains,cheakee_left-central_right)
```
